## drivers/input/misc/vl53L0/Kconfig
```kconfig
config STMVL53L0
        tristate "STM VL53L0 Ranging Sensor"
        depends on I2C
        help
          Say Y here if you want to enable the key chord driver
          This is a Time-of-Flight (ToF) laser-ranging sensor, provide
          the distance from obstacle.

          To compile this driver as a module, choose M here: the module will
          be called vl53L0.
```

## drivers/input/misc/vl53L1/Kconfig
```kconfig
config STMVL53L1
        tristate "STM VL53L1 Ranging Sensor"
        depends on I2C
        help
          Say Y here if you want to enable the key chord driver
          This is a Time-of-Flight (ToF) laser-ranging sensor, provide
          the distance from obstacle.

          To compile this driver as a module, choose M here: the module will
          be called vl53L1.
```

## drivers/input/touchscreen/ilitek_mmi/Kconfig
```kconfig
#
# ILITEK touchscreen driver configuration
#
config CONFIG_TOUCHSCREEN_ILITEK_CHIPSET
	tristate "ILITEK Touchscreen driver"
	help
	  Say Y here if you have a ILITEK touchscreen connected
	  to your system.

	  If unsure, say N.

	  To compile this driver as a module, choose M here: the
	  module will be called ilitek.
```

## drivers/misc/abov/Kconfig
```kconfig
config INPUT_ABOV
	tristate "ABOV SAR Driver"
	default n
	help
	  Say Y here to enable ABOV SAR driver.

	  To compile this driver as a module, choose M here. The module
	  will be called abov_sar.
```

## drivers/misc/aw8624/Kconfig
```kconfig
config INPUT_AW8624_HAPTIC
	tristate "AW8624 Haptic Driver"
	default n
	help
	  Say Y here to enable awinic aw8624 haptic driver.

	  To compile this driver as a module, choose M here. The module
	  will be called aw8624.
```

## drivers/misc/drv2624_mmi/Kconfig
```kconfig
config HAPTIC_DRV2624
	tristate "MMI DRV2624 HAPTIC DRIVER"
	default n
	help
	  Say Y here to enable the DRV2624 haptic driver.

	  To compile this driver as a module, choose M here. The module
	  will be called drv2624_mmi.
```

## drivers/misc/tps61280/Kconfig
```kconfig
config TPS61280
	tristate "TPS61280"
	default n
	help
	  Say Y here to enable the TPS61280 battery driver.

	  To compile this driver as a module, choose M here. The module
	  will be called tps61280.
```

## drivers/misc/utag/Kconfig
```kconfig
config MOT_UTAGS
	tristate "MOT UTAGS Driver"
	default n
	help
	  Say Y here to enable MOT UTAGS driver.

	  To compile this driver as a module, choose M here. The module
	  will be called utags.
```

## drivers/mmi_info/Kconfig
```kconfig
config MMI_INFO
	tristate "INFO driver MMI Revision"
	default n
	help
	  Say Y here to enable the INFO driver.

	  To compile this driver as a module, choose M here. The module
	  will be called mmi_info.
```

## drivers/moto_f_usbnet/Kconfig
```kconfig
config MOTO_F_USBNET
	tristate "MOTO F USBNET driver"
	default n
	help
	  Say Y here to enable the INFO driver.

	  To compile this driver as a module, choose M here. The module
	  will be called moto_f_usbnet.
```

## drivers/nfc/st21nfc/Kconfig
```kconfig
config NFC_ST21NFC
	tristate
	---help---
	  STMicroelectronics ST21NFC core driver. It implements the chipset
	  HCI logic and hooks into the NFC kernel APIs. Physical layers will
	  register against it.
```

## drivers/tzlog_dump/Kconfig
```kconfig
config TZLOG_DUMP
	tristate "TZLog Dump Driver"
	default n
	help
	  Say Y here to enable the TimeZone LOG DUMP driver.

	  To compile this driver as a module, choose M here. The module
	  will be called tzlog_dump.
```

## drivers/watchdog_cpu_ctx/Kconfig
```kconfig
#
# Watchdog device configuration
#

config WATCHDOG_CPU_CTX
	tristate "WatchDog CPU Context Driver"
	---help---
	  Say Y here if you want to use the new watchdog cpu ctx driver.
	  This driver provides cpu context support to watchdog.
```

## drivers/watchdog_test/watchdogtest/Kconfig
```kconfig
config WATCHDOG_TEST
	tristate "WatchDog Test Driver"
	---help---
	  Say Y here if you want to use the new watchdog test driver.
	  This driver provides testing support to watchdog.
```
